## nuttx_731_rx66t/nuttx/arch/renesas/src/rx66t/Kconfig
```kconfig
#
# For a description of the syntax of this configuration file,
# see the file kconfig-language.txt in the NuttX tools repository.
#

if ARCH_RX66T
comment "RX66T Configuration Options"

menu "RX66T Peripheral Selections"

config RX66T_SCI8
	bool "SCI8"
	default n
	select SCI8_SERIALDRIVER
config RX66T_SCI9
	bool "SCI9"
	default n
	select SCI9_SERIALDRIVER
config RX66T_SCI11
	bool "SCI11"
	default y
	select SCI11_SERIALDRIVER
	select SCI11_SERIAL_CONSOLE
	select ARCH_HAVE_SERIAL_TERMIOS
config RX66T_ICU
	bool "ICU"
	default y
config RX66T_CMT0
	bool "CMT0"
	default y
config RX66T_IRQ_GROUP
	bool "IRQ_GROUP"
	default y
endmenu # RX66T Peripheral Selections
endif
```

## nuttx_731_rx66t/nuttx/configs/rx65n-grrose/nsh/defconfig
```kconfig
# CONFIG_NSH_DISABLE_IFCONFIG is not set
# CONFIG_NSH_DISABLE_PS is not set
CONFIG_ARCH_BOARD_RX65N_GRROSE=y
CONFIG_ARCH_BOARD="rx65n-grrose"
CONFIG_ARCH_CHIP_R5F565NEHDFP=y
CONFIG_ARCH_RENESAS=y
CONFIG_ARCH_STACKDUMP=y
CONFIG_ARCH="renesas"
CONFIG_BOARD_LOOPSPERMSEC=15001
#CONFIG_DISABLE_MOUNTPOINT=y
#CONFIG_DISABLE_MQUEUE=y
#CONFIG_DISABLE_POLL=y
#CONFIG_DISABLE_POSIX_TIMERS=y
#CONFIG_DISABLE_PTHREAD=y
#CONFIG_DISABLE_SIGNALS=y
CONFIG_MOTOROLA_SREC=y
CONFIG_ENDIAN_LITTLE=y
CONFIG_SYSTEM_NSH=y
CONFIG_MAX_TASKS=8
CONFIG_DEBUG_FEATURES=y
#CONFIG_DEBUG_SYMBOLS=y
CONFIG_ARCH_INTERRUPTSTACK=1024
CONFIG_BUILTIN=y
CONFIG_NSH_BUILTIN_APPS=y
CONFIG_NFILE_DESCRIPTORS=8
CONFIG_NFILE_STREAMS=8
#CONFIG_NSH_CONSOLE_LOGIN=y
CONFIG_NSH_FILEIOSIZE=512
CONFIG_NSH_LINELEN=64
CONFIG_NSH_READLINE=y
CONFIG_NUNGET_CHARS=0
CONFIG_PREALLOC_TIMERS=0
CONFIG_PTHREAD_STACK_DEFAULT=1024
CONFIG_RAM_SIZE=655360
CONFIG_RAM_START=0x00000000
CONFIG_RAW_BINARY=y
CONFIG_RX65N_SCI0=y
CONFIG_RX65N_SCI1=y
CONFIG_RX65N_SCI2=y
#CONFIG_RX65N_SCI3=y
#CONFIG_RX65N_SCI4=y
CONFIG_RX65N_SCI5=y
CONFIG_RX65N_SCI6=y
CONFIG_RX65N_SCI8=y
CONFIG_RX65N_SCI11=y
#CONFIG_SCI0_SERIAL_CONSOLE=y
CONFIG_SCI0_SERIALDRIVER=y
CONFIG_SCI0_BAUD=115200
#CONFIG_SCI0_TXBUFSIZE=256
#CONFIG_SCI0_RXBUFSIZE=256
#CONFIG_SCI0_PARITY=0
#CONFIG_SCI0_BITS=8
#CONFIG_SCI0_2STOP=0
CONFIG_SCI1_SERIAL_CONSOLE=y
CONFIG_SCI1_SERIALDRIVER=y
CONFIG_SCI1_BAUD=115200
#CONFIG_SCI1_TXBUFSIZE=256
#CONFIG_SCI1_RXBUFSIZE=256
#CONFIG_SCI1_PARITY=0
#CONFIG_SCI1_BITS=8
#CONFIG_SCI1_2STOP=0
#CONFIG_SCI2_SERIAL_CONSOLE=y
CONFIG_SCI2_SERIALDRIVER=y
CONFIG_SCI2_BAUD=115200
#CONFIG_SCI2_TXBUFSIZE=256
#CONFIG_SCI2_RXBUFSIZE=256
#CONFIG_SCI2_PARITY=0
#CONFIG_SCI2_BITS=8
#CONFIG_SCI2_2STOP=0
#CONFIG_SCI3_SERIAL_CONSOLE=y
#CONFIG_SCI3_SERIALDRIVER=y
#CONFIG_SCI3_BAUD=115200
#CONFIG_SCI3_TXBUFSIZE=256
#CONFIG_SCI3_RXBUFSIZE=256
#CONFIG_SCI3_PARITY=0
#CONFIG_SCI3_BITS=8
#CONFIG_SCI3_2STOP=0
#CONFIG_SCI4_SERIAL_CONSOLE=y
#CONFIG_SCI4_SERIALDRIVER=y
#CONFIG_SCI4_BAUD=115200
#CONFIG_SCI4_TXBUFSIZE=256
#CONFIG_SCI4_RXBUFSIZE=256
#CONFIG_SCI4_PARITY=0
#CONFIG_SCI4_BITS=8
#CONFIG_SCI4_2STOP=0
#CONFIG_SCI5_SERIAL_CONSOLE=y
CONFIG_SCI5_SERIALDRIVER=y
CONFIG_SCI5_BAUD=115200
#CONFIG_SCI5_TXBUFSIZE=256
#CONFIG_SCI5_RXBUFSIZE=256
#CONFIG_SCI5_PARITY=0
#CONFIG_SCI5_BITS=8
#CONFIG_SCI5_2STOP=0
#CONFIG_SCI6_SERIAL_CONSOLE=y
CONFIG_SCI6_SERIALDRIVER=y
CONFIG_SCI6_BAUD=115200
#CONFIG_SCI6_TXBUFSIZE=256
#CONFIG_SCI6_RXBUFSIZE=256
#CONFIG_SCI6_PARITY=0
#CONFIG_SCI6_BITS=8
#CONFIG_SCI6_2STOP=0
#CONFIG_SCI7_SERIAL_CONSOLE=y
#CONFIG_SCI7_SERIALDRIVER=y
#CONFIG_SCI7_BAUD=115200
#CONFIG_SCI7_TXBUFSIZE=256
#CONFIG_SCI7_RXBUFSIZE=256
#CONFIG_SCI7_PARITY=0
#CONFIG_SCI7_BITS=8
#CONFIG_SCI7_2STOP=0
#CONFIG_SCI8_SERIAL_CONSOLE=n
CONFIG_SCI8_SERIALDRIVER=y
CONFIG_SCI8_BAUD=115200
#CONFIG_SCI8_TXBUFSIZE=256
#CONFIG_SCI8_RXBUFSIZE=256
#CONFIG_SCI8_PARITY=0
#CONFIG_SCI8_BITS=8
#CONFIG_SCI8_2STOP=0
#CONFIG_SCI11_SERIAL_CONSOLE=y
CONFIG_SCI11_SERIALDRIVER=y
CONFIG_SCI11_BAUD=115200
#CONFIG_SCI11_TXBUFSIZE=256
#CONFIG_SCI11_RXBUFSIZE=256
#CONFIG_SCI11_PARITY=0
#CONFIG_SCI11_BITS=8
#CONFIG_SCI11_2STOP=0
CONFIG_SDCLONE_DISABLE=y
CONFIG_ICU=y
CONFIG_STDIO_DISABLE_BUFFERING=y
CONFIG_TASK_NAME_SIZE=0
CONFIG_USER_ENTRYPOINT="nsh_main"
CONFIG_USERMAIN_STACKSIZE=1024
CONFIG_IDLETHREAD_STACKSIZE=1024
#CONFIG_LIBC_FLOATINGPOINT=y
```

## nuttx_731_rx66t/nuttx/configs/rx66t/nsh/defconfig
```kconfig
# CONFIG_NSH_DISABLE_IFCONFIG is not set
# CONFIG_NSH_DISABLE_PS is not set
CONFIG_ARCH_BOARD_RX66T=y
CONFIG_ARCH_BOARD="rx66t"
CONFIG_ARCH_CHIP_R5F566TKCDFP=y
CONFIG_ARCH_RENESAS=y
CONFIG_ARCH_STACKDUMP=y
CONFIG_ARCH="renesas"
CONFIG_BOARD_LOOPSPERMSEC=15001
#CONFIG_DISABLE_MOUNTPOINT=y
#CONFIG_DISABLE_MQUEUE=y
#CONFIG_DISABLE_POLL=y
#CONFIG_DISABLE_POSIX_TIMERS=y
#CONFIG_DISABLE_PTHREAD=y
#CONFIG_DISABLE_SIGNALS=y
CONFIG_MOTOROLA_SREC=y
CONFIG_ENDIAN_LITTLE=y
CONFIG_SYSTEM_NSH=y
CONFIG_MAX_TASKS=8
CONFIG_DEBUG_FEATURES=y
#CONFIG_DEBUG_SYMBOLS=y
CONFIG_ARCH_INTERRUPTSTACK=1024
CONFIG_BUILTIN=y
CONFIG_NSH_BUILTIN_APPS=y
CONFIG_NFILE_DESCRIPTORS=8
CONFIG_NFILE_STREAMS=8
#CONFIG_NSH_CONSOLE_LOGIN=y
CONFIG_NSH_FILEIOSIZE=512
CONFIG_NSH_LINELEN=64
CONFIG_NSH_READLINE=y
CONFIG_NUNGET_CHARS=0
CONFIG_PREALLOC_TIMERS=0
CONFIG_PTHREAD_STACK_DEFAULT=1024
CONFIG_RAM_SIZE=131072
CONFIG_RAM_START=0x00000000
CONFIG_RAW_BINARY=y
CONFIG_RX66T_SCI8=y
CONFIG_RX66T_SCI9=y
CONFIG_RX66T_SCI11=y
#CONFIG_SCI8_SERIAL_CONSOLE=n
CONFIG_SCI8_SERIALDRIVER=y
CONFIG_SCI8_BAUD=1000000
#CONFIG_SCI8_TXBUFSIZE=256
#CONFIG_SCI8_RXBUFSIZE=256
#CONFIG_SCI8_PARITY=0
#CONFIG_SCI8_BITS=8
#CONFIG_SCI8_2STOP=0
#CONFIG_SCI9_SERIAL_CONSOLE=n
CONFIG_SCI9_SERIALDRIVER=y
CONFIG_SCI9_BAUD=1000000
#CONFIG_SCI9_TXBUFSIZE=256
#CONFIG_SCI9_RXBUFSIZE=256
#CONFIG_SCI9_PARITY=0
#CONFIG_SCI9_BITS=8
#CONFIG_SCI9_2STOP=0
CONFIG_SCI11_SERIAL_CONSOLE=y
CONFIG_SCI11_SERIALDRIVER=y
CONFIG_SCI11_BAUD=1000000
#CONFIG_SCI11_TXBUFSIZE=256
#CONFIG_SCI11_RXBUFSIZE=256
#CONFIG_SCI11_PARITY=0
#CONFIG_SCI11_BITS=8
#CONFIG_SCI11_2STOP=0
CONFIG_SDCLONE_DISABLE=y
CONFIG_ICU=y
CONFIG_STDIO_DISABLE_BUFFERING=y
CONFIG_TASK_NAME_SIZE=0
CONFIG_USER_ENTRYPOINT="nsh_main"
CONFIG_USERMAIN_STACKSIZE=1024
CONFIG_IDLETHREAD_STACKSIZE=1024
#CONFIG_LIBC_FLOATINGPOINT=y
```
